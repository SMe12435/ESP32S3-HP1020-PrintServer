## firmware/sdkconfig.defaults
```kconfig
CONFIG_USB_OTG_SUPPORTED=y
CONFIG_USB_HOST_CONTROL_TRANSFER_MAX_SIZE=1024
CONFIG_USB_HOST_HW_BUFFER_BIAS_BALANCED=y

CONFIG_SPIRAM=y
CONFIG_SPIRAM_MODE_OCT=y
CONFIG_SPIRAM_SPEED_80M=y
CONFIG_SPIRAM_MALLOC_ALWAYSINTERNAL=4096

CONFIG_ESP_MAIN_TASK_STACK_SIZE=8192

CONFIG_PARTITION_TABLE_CUSTOM=y
CONFIG_PARTITION_TABLE_CUSTOM_FILENAME="partitions.csv"

CONFIG_ESP_TLS_USING_MBEDTLS=y
CONFIG_MBEDTLS_CERTIFICATE_BUNDLE=y
CONFIG_MBEDTLS_CERTIFICATE_BUNDLE_DEFAULT_FULL=y
CONFIG_ESP_HTTP_CLIENT_ENABLE_HTTPS=y

CONFIG_HTTPD_MAX_REQ_HDR_LEN=1024

CONFIG_FREERTOS_HZ=1000
CONFIG_ESP_WIFI_SOFTAP_SUPPORT=y

CONFIG_WIFI_SSID="YourNetwork"
CONFIG_WIFI_PASS="YourPassword"
CONFIG_CLOUD_URL="wss://print.example.com"
CONFIG_CLOUD_API_KEY="change-me-to-a-random-key"
```

## firmware/src/Kconfig.projbuild
```kconfig
menu "Print Server Configuration"

config WIFI_SSID
    string "WiFi SSID"
    default "YourNetwork"
    help
        SSID of the WiFi network to connect to.

config WIFI_PASS
    string "WiFi Password"
    default "YourPassword"
    help
        Password for the WiFi network.

config CLOUD_URL
    string "Cloud Server URL"
    default "http://print.example.com:5000"
    help
        HTTP URL of the print server (e.g. http://65.2.99.92:5000).

config CLOUD_API_KEY
    string "Device API Key"
    default "change-me-to-a-random-key"
    help
        API key for authenticating with the cloud server.

endmenu
```
